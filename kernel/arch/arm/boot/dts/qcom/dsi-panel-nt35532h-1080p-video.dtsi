/* Copyright (c) 2013, The Linux Foundation. All rights reserved.
 *
 * This program is free software; you can redistribute it and/or modify
 * it under the terms of the GNU General Public License version 2 and
 * only version 2 as published by the Free Software Foundation.
 *
 * This program is distributed in the hope that it will be useful,
 * but WITHOUT ANY WARRANTY; without even the implied warranty of
 * MERCHANTABILITY or FITNESS FOR A PARTICULAR PURPOSE.  See the
 * GNU General Public License for more details.
 */

/*---------------------------------------------------------------------------
 * This file is autogenerated file using gcdb parser. Please do not edit it.
 * Update input XML file to add a new entry or update variable in this file
 * VERSION = "1.0"
 *---------------------------------------------------------------------------*/
&mdss_mdp {
	dsi_nt35532h_1080p_video: qcom,mdss_dsi_nt35532h_1080p_video {
		qcom,mdss-dsi-panel-name = "nt35532h 1080p video mode dsi panel";
		qcom,mdss-dsi-panel-controller = <&mdss_dsi0>;
		qcom,mdss-dsi-panel-type = "dsi_video_mode";
		qcom,mdss-dsi-panel-destination = "display_1";
		qcom,mdss-dsi-panel-framerate = <60>;
		qcom,mdss-dsi-virtual-channel-id = <0>;
		qcom,mdss-dsi-stream = <0>;
		qcom,mdss-dsi-panel-width = <1080>;
		qcom,mdss-dsi-panel-height = <1920>;
		qcom,mdss-dsi-h-front-porch = <52>;
		qcom,mdss-dsi-h-back-porch = <72>;
		qcom,mdss-dsi-h-pulse-width = <8>;
		qcom,mdss-dsi-h-sync-skew = <0>;
		qcom,mdss-dsi-v-front-porch = <19>;
		qcom,mdss-dsi-v-back-porch = <20>;
		qcom,mdss-dsi-v-pulse-width = <2>;
		qcom,mdss-dsi-h-left-border = <0>;
		qcom,mdss-dsi-h-right-border = <0>;
		qcom,mdss-dsi-v-top-border = <0>;
		qcom,mdss-dsi-v-bottom-border = <0>;
		qcom,mdss-dsi-bpp = <24>;
		qcom,mdss-dsi-color-order = "rgb_swap_rgb";
		qcom,mdss-dsi-underflow-color = <0xff>;
		qcom,mdss-dsi-border-color = <0>;
		qcom,cont-splash-enabled;
		qcom,mdss-dsi-on-command = [15 01 00 00 00 00 02 FF 01
			15 01 00 00 00 00 02 FB 01
			15 01 00 00 00 00 02 6E 10 // Auto porch
			15 01 00 00 00 00 02 00 01
			15 01 00 00 00 00 02 01 55
			15 01 00 00 00 00 02 02 59
			15 01 00 00 00 00 02 04 0C
			15 01 00 00 00 00 02 05 2B
			15 01 00 00 00 00 02 06 64
			15 01 00 00 00 00 02 07 C6
			15 01 00 00 00 00 02 0D 89
			15 01 00 00 00 00 02 0E 89
			15 01 00 00 00 00 02 0F E0
			15 01 00 00 00 00 02 10 03
			15 01 00 00 00 00 02 11 5A
			15 01 00 00 00 00 02 12 5A
			15 01 00 00 00 00 02 13 9B
			15 01 00 00 00 00 02 14 9B
			15 01 00 00 00 00 02 15 60
			15 01 00 00 00 00 02 16 13
			15 01 00 00 00 00 02 17 13
			15 01 00 00 00 00 02 1C A3
			15 01 00 00 00 00 02 60 77
			15 01 00 00 00 00 02 75 00
			15 01 00 00 00 00 02 76 77
			15 01 00 00 00 00 02 77 00
			15 01 00 00 00 00 02 78 78
			15 01 00 00 00 00 02 79 00
			15 01 00 00 00 00 02 7A 9E
			15 01 00 00 00 00 02 7B 00
			15 01 00 00 00 00 02 7C BD
			15 01 00 00 00 00 02 7D 00
			15 01 00 00 00 00 02 7E D4
			15 01 00 00 00 00 02 7F 00
			15 01 00 00 00 00 02 80 E8
			15 01 00 00 00 00 02 81 00
			15 01 00 00 00 00 02 82 F9
			15 01 00 00 00 00 02 83 01
			15 01 00 00 00 00 02 84 08
			15 01 00 00 00 00 02 85 01
			15 01 00 00 00 00 02 86 16
			15 01 00 00 00 00 02 87 01
			15 01 00 00 00 00 02 88 44
			15 01 00 00 00 00 02 89 01
			15 01 00 00 00 00 02 8A 67
			15 01 00 00 00 00 02 8B 01
			15 01 00 00 00 00 02 8C 9F
			15 01 00 00 00 00 02 8D 01
			15 01 00 00 00 00 02 8E CB
			15 01 00 00 00 00 02 8F 02
			15 01 00 00 00 00 02 90 0F
			15 01 00 00 00 00 02 91 02
			15 01 00 00 00 00 02 92 46
			15 01 00 00 00 00 02 93 02
			15 01 00 00 00 00 02 94 47
			15 01 00 00 00 00 02 95 02
			15 01 00 00 00 00 02 96 7A
			15 01 00 00 00 00 02 97 02
			15 01 00 00 00 00 02 98 B4
			15 01 00 00 00 00 02 99 02
			15 01 00 00 00 00 02 9A D7
			15 01 00 00 00 00 02 9B 03
			15 01 00 00 00 00 02 9C 08
			15 01 00 00 00 00 02 9D 03
			15 01 00 00 00 00 02 9E 27
			15 01 00 00 00 00 02 9F 03
			15 01 00 00 00 00 02 A0 4E
			15 01 00 00 00 00 02 A2 03
			15 01 00 00 00 00 02 A3 5B
			15 01 00 00 00 00 02 A4 03
			15 01 00 00 00 00 02 A5 67
			15 01 00 00 00 00 02 A6 03
			15 01 00 00 00 00 02 A7 75
			15 01 00 00 00 00 02 A9 03
			15 01 00 00 00 00 02 AA 85
			15 01 00 00 00 00 02 AB 03
			15 01 00 00 00 00 02 AC 95
			15 01 00 00 00 00 02 AD 03
			15 01 00 00 00 00 02 AE AA
			15 01 00 00 00 00 02 AF 03
			15 01 00 00 00 00 02 B0 D0
			15 01 00 00 00 00 02 B1 03
			15 01 00 00 00 00 02 B2 DC
			15 01 00 00 00 00 02 B3 00
			15 01 00 00 00 00 02 B4 18
			15 01 00 00 00 00 02 B5 00
			15 01 00 00 00 00 02 B6 6A
			15 01 00 00 00 00 02 B7 00
			15 01 00 00 00 00 02 B8 9E
			15 01 00 00 00 00 02 B9 00
			15 01 00 00 00 00 02 BA BD
			15 01 00 00 00 00 02 BB 00
			15 01 00 00 00 00 02 BC D4
			15 01 00 00 00 00 02 BD 00
			15 01 00 00 00 00 02 BE E8
			15 01 00 00 00 00 02 BF 00
			15 01 00 00 00 00 02 C0 F9
			15 01 00 00 00 00 02 C1 01
			15 01 00 00 00 00 02 C2 08
			15 01 00 00 00 00 02 C3 01
			15 01 00 00 00 00 02 C4 16
			15 01 00 00 00 00 02 C5 01
			15 01 00 00 00 00 02 C6 44
			15 01 00 00 00 00 02 C7 01
			15 01 00 00 00 00 02 C8 67
			15 01 00 00 00 00 02 C9 01
			15 01 00 00 00 00 02 CA 9F
			15 01 00 00 00 00 02 CB 01
			15 01 00 00 00 00 02 CC CB
			15 01 00 00 00 00 02 CD 02
			15 01 00 00 00 00 02 CE 0F
			15 01 00 00 00 00 02 CF 02
			15 01 00 00 00 00 02 D0 46
			15 01 00 00 00 00 02 D1 02
			15 01 00 00 00 00 02 D2 47
			15 01 00 00 00 00 02 D3 02
			15 01 00 00 00 00 02 D4 7A
			15 01 00 00 00 00 02 D5 02
			15 01 00 00 00 00 02 D6 B4
			15 01 00 00 00 00 02 D7 02
			15 01 00 00 00 00 02 D8 D7
			15 01 00 00 00 00 02 D9 03
			15 01 00 00 00 00 02 DA 08
			15 01 00 00 00 00 02 DB 03
			15 01 00 00 00 00 02 DC 27
			15 01 00 00 00 00 02 DD 03
			15 01 00 00 00 00 02 DE 4E
			15 01 00 00 00 00 02 DF 03
			15 01 00 00 00 00 02 E0 5B
			15 01 00 00 00 00 02 E1 03
			15 01 00 00 00 00 02 E2 67
			15 01 00 00 00 00 02 E3 03
			15 01 00 00 00 00 02 E4 75
			15 01 00 00 00 00 02 E5 03
			15 01 00 00 00 00 02 E6 85
			15 01 00 00 00 00 02 E7 03
			15 01 00 00 00 00 02 E8 95
			15 01 00 00 00 00 02 E9 03
			15 01 00 00 00 00 02 EA AA
			15 01 00 00 00 00 02 EB 03
			15 01 00 00 00 00 02 EC D0
			15 01 00 00 00 00 02 ED 03
			15 01 00 00 00 00 02 EE DC
			15 01 00 00 00 00 02 EF 00
			15 01 00 00 00 00 02 F0 77
			15 01 00 00 00 00 02 F1 00
			15 01 00 00 00 00 02 F2 78
			15 01 00 00 00 00 02 F3 00
			15 01 00 00 00 00 02 F4 9E
			15 01 00 00 00 00 02 F5 00
			15 01 00 00 00 00 02 F6 BD
			15 01 00 00 00 00 02 F7 00
			15 01 00 00 00 00 02 F8 D4
			15 01 00 00 00 00 02 F9 00
			15 01 00 00 00 00 02 FA E8
			15 01 00 00 00 00 02 FF 02
			15 01 00 00 00 00 02 FB 01
			15 01 00 00 00 00 02 00 00
			15 01 00 00 00 00 02 01 F9
			15 01 00 00 00 00 02 02 01
			15 01 00 00 00 00 02 03 08
			15 01 00 00 00 00 02 04 01
			15 01 00 00 00 00 02 05 16
			15 01 00 00 00 00 02 06 01
			15 01 00 00 00 00 02 07 44
			15 01 00 00 00 00 02 08 01
			15 01 00 00 00 00 02 09 67
			15 01 00 00 00 00 02 0A 01
			15 01 00 00 00 00 02 0B 9F
			15 01 00 00 00 00 02 0C 01
			15 01 00 00 00 00 02 0D CB
			15 01 00 00 00 00 02 0E 02
			15 01 00 00 00 00 02 0F 0F
			15 01 00 00 00 00 02 10 02
			15 01 00 00 00 00 02 11 46
			15 01 00 00 00 00 02 12 02
			15 01 00 00 00 00 02 13 47
			15 01 00 00 00 00 02 14 02
			15 01 00 00 00 00 02 15 7A
			15 01 00 00 00 00 02 16 02
			15 01 00 00 00 00 02 17 B4
			15 01 00 00 00 00 02 18 02
			15 01 00 00 00 00 02 19 D7
			15 01 00 00 00 00 02 1A 03
			15 01 00 00 00 00 02 1B 08
			15 01 00 00 00 00 02 1C 03
			15 01 00 00 00 00 02 1D 27
			15 01 00 00 00 00 02 1E 03
			15 01 00 00 00 00 02 1F 4E
			15 01 00 00 00 00 02 20 03
			15 01 00 00 00 00 02 21 5B
			15 01 00 00 00 00 02 22 03
			15 01 00 00 00 00 02 23 67
			15 01 00 00 00 00 02 24 03
			15 01 00 00 00 00 02 25 75
			15 01 00 00 00 00 02 26 03
			15 01 00 00 00 00 02 27 85
			15 01 00 00 00 00 02 28 03
			15 01 00 00 00 00 02 29 95
			15 01 00 00 00 00 02 2A 03
			15 01 00 00 00 00 02 2B AA
			15 01 00 00 00 00 02 2D 03
			15 01 00 00 00 00 02 2F D0
			15 01 00 00 00 00 02 30 03
			15 01 00 00 00 00 02 31 DC
			15 01 00 00 00 00 02 32 00
			15 01 00 00 00 00 02 33 18
			15 01 00 00 00 00 02 34 00
			15 01 00 00 00 00 02 35 6A
			15 01 00 00 00 00 02 36 00
			15 01 00 00 00 00 02 37 9E
			15 01 00 00 00 00 02 38 00
			15 01 00 00 00 00 02 39 BD
			15 01 00 00 00 00 02 3A 00
			15 01 00 00 00 00 02 3B D4
			15 01 00 00 00 00 02 3D 00
			15 01 00 00 00 00 02 3F E8
			15 01 00 00 00 00 02 40 00
			15 01 00 00 00 00 02 41 F9
			15 01 00 00 00 00 02 42 01
			15 01 00 00 00 00 02 43 08
			15 01 00 00 00 00 02 44 01
			15 01 00 00 00 00 02 45 16
			15 01 00 00 00 00 02 46 01
			15 01 00 00 00 00 02 47 44
			15 01 00 00 00 00 02 48 01
			15 01 00 00 00 00 02 49 67
			15 01 00 00 00 00 02 4A 01
			15 01 00 00 00 00 02 4B 9F
			15 01 00 00 00 00 02 4C 01
			15 01 00 00 00 00 02 4D CB
			15 01 00 00 00 00 02 4E 02
			15 01 00 00 00 00 02 4F 0F
			15 01 00 00 00 00 02 50 02
			15 01 00 00 00 00 02 51 46
			15 01 00 00 00 00 02 52 02
			15 01 00 00 00 00 02 53 47
			15 01 00 00 00 00 02 54 02
			15 01 00 00 00 00 02 55 7A
			15 01 00 00 00 00 02 56 02
			15 01 00 00 00 00 02 58 B4
			15 01 00 00 00 00 02 59 02
			15 01 00 00 00 00 02 5A D7
			15 01 00 00 00 00 02 5B 03
			15 01 00 00 00 00 02 5C 08
			15 01 00 00 00 00 02 5D 03
			15 01 00 00 00 00 02 5E 27
			15 01 00 00 00 00 02 5F 03
			15 01 00 00 00 00 02 60 4E
			15 01 00 00 00 00 02 61 03
			15 01 00 00 00 00 02 62 5B
			15 01 00 00 00 00 02 63 03
			15 01 00 00 00 00 02 64 67
			15 01 00 00 00 00 02 65 03
			15 01 00 00 00 00 02 66 75
			15 01 00 00 00 00 02 67 03
			15 01 00 00 00 00 02 68 85
			15 01 00 00 00 00 02 69 03
			15 01 00 00 00 00 02 6A 95
			15 01 00 00 00 00 02 6B 03
			15 01 00 00 00 00 02 6C AA
			15 01 00 00 00 00 02 6D 03
			15 01 00 00 00 00 02 6E D0
			15 01 00 00 00 00 02 6F 03
			15 01 00 00 00 00 02 70 DC
			15 01 00 00 00 00 02 71 00
			15 01 00 00 00 00 02 72 77
			15 01 00 00 00 00 02 73 00
			15 01 00 00 00 00 02 74 78
			15 01 00 00 00 00 02 75 00
			15 01 00 00 00 00 02 76 9E
			15 01 00 00 00 00 02 77 00
			15 01 00 00 00 00 02 78 BD
			15 01 00 00 00 00 02 79 00
			15 01 00 00 00 00 02 7A D4
			15 01 00 00 00 00 02 7B 00
			15 01 00 00 00 00 02 7C E8
			15 01 00 00 00 00 02 7D 00
			15 01 00 00 00 00 02 7E F9
			15 01 00 00 00 00 02 7F 01
			15 01 00 00 00 00 02 80 08
			15 01 00 00 00 00 02 81 01
			15 01 00 00 00 00 02 82 16
			15 01 00 00 00 00 02 83 01
			15 01 00 00 00 00 02 84 44
			15 01 00 00 00 00 02 85 01
			15 01 00 00 00 00 02 86 67
			15 01 00 00 00 00 02 87 01
			15 01 00 00 00 00 02 88 9F
			15 01 00 00 00 00 02 89 01
			15 01 00 00 00 00 02 8A CB
			15 01 00 00 00 00 02 8B 02
			15 01 00 00 00 00 02 8C 0F
			15 01 00 00 00 00 02 8D 02
			15 01 00 00 00 00 02 8E 46
			15 01 00 00 00 00 02 8F 02
			15 01 00 00 00 00 02 90 47
			15 01 00 00 00 00 02 91 02
			15 01 00 00 00 00 02 92 7A
			15 01 00 00 00 00 02 93 02
			15 01 00 00 00 00 02 94 B4
			15 01 00 00 00 00 02 95 02
			15 01 00 00 00 00 02 96 D7
			15 01 00 00 00 00 02 97 03
			15 01 00 00 00 00 02 98 08
			15 01 00 00 00 00 02 99 03
			15 01 00 00 00 00 02 9A 27
			15 01 00 00 00 00 02 9B 03
			15 01 00 00 00 00 02 9C 4E
			15 01 00 00 00 00 02 9D 03
			15 01 00 00 00 00 02 9E 5B
			15 01 00 00 00 00 02 9F 03
			15 01 00 00 00 00 02 A0 67
			15 01 00 00 00 00 02 A2 03
			15 01 00 00 00 00 02 A3 75
			15 01 00 00 00 00 02 A4 03
			15 01 00 00 00 00 02 A5 85
			15 01 00 00 00 00 02 A6 03
			15 01 00 00 00 00 02 A7 95
			15 01 00 00 00 00 02 A9 03
			15 01 00 00 00 00 02 AA AA
			15 01 00 00 00 00 02 AB 03
			15 01 00 00 00 00 02 AC D0
			15 01 00 00 00 00 02 AD 03
			15 01 00 00 00 00 02 AE DC
			15 01 00 00 00 00 02 AF 00
			15 01 00 00 00 00 02 B0 18
			15 01 00 00 00 00 02 B1 00
			15 01 00 00 00 00 02 B2 6A
			15 01 00 00 00 00 02 B3 00
			15 01 00 00 00 00 02 B4 9E
			15 01 00 00 00 00 02 B5 00
			15 01 00 00 00 00 02 B6 BD
			15 01 00 00 00 00 02 B7 00
			15 01 00 00 00 00 02 B8 D4
			15 01 00 00 00 00 02 B9 00
			15 01 00 00 00 00 02 BA E8
			15 01 00 00 00 00 02 BB 00
			15 01 00 00 00 00 02 BC F9
			15 01 00 00 00 00 02 BD 01
			15 01 00 00 00 00 02 BE 08
			15 01 00 00 00 00 02 BF 01
			15 01 00 00 00 00 02 C0 16
			15 01 00 00 00 00 02 C1 01
			15 01 00 00 00 00 02 C2 44
			15 01 00 00 00 00 02 C3 01
			15 01 00 00 00 00 02 C4 67
			15 01 00 00 00 00 02 C5 01
			15 01 00 00 00 00 02 C6 9F
			15 01 00 00 00 00 02 C7 01
			15 01 00 00 00 00 02 C8 CB
			15 01 00 00 00 00 02 C9 02
			15 01 00 00 00 00 02 CA 0F
			15 01 00 00 00 00 02 CB 02
			15 01 00 00 00 00 02 CC 46
			15 01 00 00 00 00 02 CD 02
			15 01 00 00 00 00 02 CE 47
			15 01 00 00 00 00 02 CF 02
			15 01 00 00 00 00 02 D0 7A
			15 01 00 00 00 00 02 D1 02
			15 01 00 00 00 00 02 D2 B4
			15 01 00 00 00 00 02 D3 02
			15 01 00 00 00 00 02 D4 D7
			15 01 00 00 00 00 02 D5 03
			15 01 00 00 00 00 02 D6 08
			15 01 00 00 00 00 02 D7 03
			15 01 00 00 00 00 02 D8 27
			15 01 00 00 00 00 02 D9 03
			15 01 00 00 00 00 02 DA 4E
			15 01 00 00 00 00 02 DB 03
			15 01 00 00 00 00 02 DC 5B
			15 01 00 00 00 00 02 DD 03
			15 01 00 00 00 00 02 DE 67
			15 01 00 00 00 00 02 DF 03
			15 01 00 00 00 00 02 E0 75
			15 01 00 00 00 00 02 E1 03
			15 01 00 00 00 00 02 E2 85
			15 01 00 00 00 00 02 E3 03
			15 01 00 00 00 00 02 E4 95
			15 01 00 00 00 00 02 E5 03
			15 01 00 00 00 00 02 E6 AA
			15 01 00 00 00 00 02 E7 03
			15 01 00 00 00 00 02 E8 D0
			15 01 00 00 00 00 02 E9 03
			15 01 00 00 00 00 02 EA DC
			15 01 00 00 00 00 02 FF 05
			15 01 00 00 00 00 02 FB 01
			15 01 00 00 00 00 02 00 38
			15 01 00 00 00 00 02 01 38
			15 01 00 00 00 00 02 02 07
			15 01 00 00 00 00 02 03 40
			15 01 00 00 00 00 02 04 40
			15 01 00 00 00 00 02 05 25
			15 01 00 00 00 00 02 06 1D
			15 01 00 00 00 00 02 07 23
			15 01 00 00 00 00 02 08 1B
			15 01 00 00 00 00 02 09 21
			15 01 00 00 00 00 02 0A 19
			15 01 00 00 00 00 02 0B 1F
			15 01 00 00 00 00 02 0C 17
			15 01 00 00 00 00 02 0D 05
			15 01 00 00 00 00 02 0E 04
			15 01 00 00 00 00 02 0F 0F
			15 01 00 00 00 00 02 10 38
			15 01 00 00 00 00 02 11 38
			15 01 00 00 00 00 02 12 38
			15 01 00 00 00 00 02 13 38
			15 01 00 00 00 00 02 14 38
			15 01 00 00 00 00 02 15 38
			15 01 00 00 00 00 02 16 06
			15 01 00 00 00 00 02 17 40
			15 01 00 00 00 00 02 18 40
			15 01 00 00 00 00 02 19 24
			15 01 00 00 00 00 02 1A 1C
			15 01 00 00 00 00 02 1B 22
			15 01 00 00 00 00 02 1C 1A
			15 01 00 00 00 00 02 1D 20
			15 01 00 00 00 00 02 1E 18
			15 01 00 00 00 00 02 1F 1E
			15 01 00 00 00 00 02 20 16
			15 01 00 00 00 00 02 21 05
			15 01 00 00 00 00 02 22 04
			15 01 00 00 00 00 02 23 0E
			15 01 00 00 00 00 02 24 38
			15 01 00 00 00 00 02 25 38
			15 01 00 00 00 00 02 26 38
			15 01 00 00 00 00 02 27 38
			15 01 00 00 00 00 02 28 38
			15 01 00 00 00 00 02 29 38
			15 01 00 00 00 00 02 2A 0E
			15 01 00 00 00 00 02 2B 40
			15 01 00 00 00 00 02 2D 40
			15 01 00 00 00 00 02 2F 16
			15 01 00 00 00 00 02 30 1E
			15 01 00 00 00 00 02 31 18
			15 01 00 00 00 00 02 32 20
			15 01 00 00 00 00 02 33 1A
			15 01 00 00 00 00 02 34 22
			15 01 00 00 00 00 02 35 1C
			15 01 00 00 00 00 02 36 24
			15 01 00 00 00 00 02 37 05
			15 01 00 00 00 00 02 38 04
			15 01 00 00 00 00 02 39 06
			15 01 00 00 00 00 02 3A 38
			15 01 00 00 00 00 02 3B 38
			15 01 00 00 00 00 02 3D 38
			15 01 00 00 00 00 02 3F 38
			15 01 00 00 00 00 02 40 38
			15 01 00 00 00 00 02 41 38
			15 01 00 00 00 00 02 42 0F
			15 01 00 00 00 00 02 43 40
			15 01 00 00 00 00 02 44 40
			15 01 00 00 00 00 02 45 17
			15 01 00 00 00 00 02 46 1F
			15 01 00 00 00 00 02 47 19
			15 01 00 00 00 00 02 48 21
			15 01 00 00 00 00 02 49 1B
			15 01 00 00 00 00 02 4A 23
			15 01 00 00 00 00 02 4B 1D
			15 01 00 00 00 00 02 4C 25
			15 01 00 00 00 00 02 4D 05
			15 01 00 00 00 00 02 4E 04
			15 01 00 00 00 00 02 4F 07
			15 01 00 00 00 00 02 50 38
			15 01 00 00 00 00 02 51 38
			15 01 00 00 00 00 02 52 38
			15 01 00 00 00 00 02 53 38
			15 01 00 00 00 00 02 5B 0A
			15 01 00 00 00 00 02 5C 0A
			15 01 00 00 00 00 02 63 0A
			15 01 00 00 00 00 02 64 15
			15 01 00 00 00 00 02 68 24
			15 01 00 00 00 00 02 69 24
			15 01 00 00 00 00 02 90 7B
			15 01 00 00 00 00 02 91 11
			15 01 00 00 00 00 02 92 14
			15 01 00 00 00 00 02 7E 10
			15 01 00 00 00 00 02 7F 10
			15 01 00 00 00 00 02 80 00
			15 01 00 00 00 00 02 98 00
			15 01 00 00 00 00 02 99 00
			15 01 00 00 00 00 02 54 2E
			15 01 00 00 00 00 02 59 38
			15 01 00 00 00 00 02 5D 01
			15 01 00 00 00 00 02 5E 27
			15 01 00 00 00 00 02 62 39
			15 01 00 00 00 00 02 66 88
			15 01 00 00 00 00 02 67 11
			15 01 00 00 00 00 02 6A 0E
			15 01 00 00 00 00 02 6B 20
			15 01 00 00 00 00 02 6C 08
			15 01 00 00 00 00 02 6D 00
			15 01 00 00 00 00 02 7D 01
			15 01 00 00 00 00 02 B7 01
			15 01 00 00 00 00 02 B8 0A
			15 01 00 00 00 00 02 BA 13
			15 01 00 00 00 00 02 BC 01
			15 01 00 00 00 00 02 BD 55
			15 01 00 00 00 00 02 BE 38
			15 01 00 00 00 00 02 BF 44
			15 01 00 00 00 00 02 CF 88
			15 01 00 00 00 00 02 C8 00
			15 01 00 00 00 00 02 C9 55
			15 01 00 00 00 00 02 CA 00
			15 01 00 00 00 00 02 CB 55
			15 01 00 00 00 00 02 CC A2
			15 01 00 00 00 00 02 CE 88
			15 01 00 00 00 00 02 CF 88
			15 01 00 00 00 00 02 D0 00
			15 01 00 00 00 00 02 D1 00
			15 01 00 00 00 00 02 D3 00
			15 01 00 00 00 00 02 D5 00
			15 01 00 00 00 00 02 D6 22
			15 01 00 00 00 00 02 D7 31
			15 01 00 00 00 00 02 D8 7E
			15 01 00 00 00 00 02 FF 00
			15 01 00 00 00 00 02 D3 14 // VB
			15 01 00 00 00 00 02 D4 13 // VF
			15 01 00 00 00 00 02 D5 48 // HB
			15 01 00 00 00 00 02 D6 34 // HF
			15 01 00 00 00 00 02 D7 00
			//15 01 00 00 00 00 02 36 D4 // reverse sweep
			//15 01 00 00 78 00 02 ff 05 // test mode
			//15 01 00 00 32 00 02 EA FF // test mode
			//15 01 00 00 00 00 02 EB 1F // test mode
			//15 01 00 00 00 00 02 EC 21 // test mode
			//15 01 00 00 00 00 02 51 73 // set pwm 45% duty
			//15 01 00 00 00 00 02 53 2C // set pwm
			//15 01 00 00 00 00 02 55 00 // set pwm
			05 01 00 00 69 00 02 11 00
			05 01 00 00 2D 00 02 29 00];
		qcom,mdss-dsi-off-command = [05 01 00 00 32 00 02 28 00
					05 01 00 00 78 00 02 10 00];
		qcom,mdss-dsi-on-command-state = "dsi_lp_mode";
		qcom,mdss-dsi-off-command-state = "dsi_hs_mode";
		qcom,mdss-dsi-h-sync-pulse = <1>;
		qcom,mdss-dsi-traffic-mode = "burst_mode";
		qcom,mdss-dsi-lane-map = "lane_map_0123";
		qcom,mdss-dsi-bllp-eof-power-mode;
		qcom,mdss-dsi-bllp-power-mode;
		qcom,mdss-dsi-lane-0-state;
		qcom,mdss-dsi-lane-1-state;
		qcom,mdss-dsi-lane-2-state;
		qcom,mdss-dsi-lane-3-state;
		qcom,mdss-dsi-panel-timings = [E2 36 24 00 66 68 28 38 2A 03 04 00];
		qcom,mdss-dsi-t-clk-post = <0x02>;
		qcom,mdss-dsi-t-clk-pre = <0x2A>;
		qcom,mdss-dsi-bl-min-level = <1>;
		qcom,mdss-dsi-bl-max-level = <4095>;
		//qcom,mdss-brightness-max-level = <4095>;
		qcom,mdss-dsi-dma-trigger = "trigger_sw";
		qcom,mdss-dsi-mdp-trigger = "none";
		qcom,mdss-dsi-bl-pmic-control-type = "bl_ctrl_wled";
		qcom,mdss-dsi-reset-sequence = <1 5>, <0 2>, <1 15>;
		qcom,platform-vendor-id = <&msm_gpio 130 0>;
		qcom,mdss-pan-physical-width-dimension = <68>;
		qcom,mdss-pan-physical-height-dimension = <121>;
	};
};
