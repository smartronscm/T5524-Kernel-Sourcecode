
qcom,qrd_msm8952_phoenix_3025mah {
	/* #2453621_SIM_8956US_6PX501_3025mAh_averaged_MasterSlave_Jun10th2016*/
	qcom,max-voltage-uv = <4400000>;
	qcom,nom-batt-capacity-mah = <3025>;
	qcom,batt-id-kohm = <100 20>;
	qcom,battery-beta = <3380>;
	qcom,battery-type = "qrd_msm8952_phoenix_3025mah";
	qcom,fastchg-current-ma = <2000>;
	qcom,fg-cc-cv-threshold-mv = <4390>;
	qcom,chg-rslow-comp-c1 = <3415273>;
	qcom,chg-rslow-comp-c2 = <5266618>;
	qcom,chg-rs-to-rslow = <753029>;
	qcom,chg-rslow-comp-thr = <0xAC>;
	qcom,checksum = <0xBD07>;
	qcom,gui-version = "PMI8950GUI - 2.0.0.16";
	qcom,fg-profile-data = [
		 F1 83 79 7D
		 9A 81 16 7C
		 5D 83 00 6C
		 5B 83 EB 8D
		 36 82 EE 98
		 03 B7 B2 C2
		 58 13 F7 83
		 2C 7D 47 81
		 79 77 61 83
		 02 64 07 88
		 C6 8F 55 82
		 B3 99 0A BD
		 02 CA 52 0D
		 53 0C 60 5B
		 14 70 74 FE
		 6C 44 B1 3E
		 93 41 00 00
		 41 44 1C 38
		 DD 3F 00 00
		 00 00 00 00
		 00 00 00 00
		 5A 6A 51 69
		 27 71 55 8A
		 81 75 41 69
		 16 6D 1F 7A
		 95 74 3A 68
		 9C 69 85 AB
		 1B AA 62 CC
		 64 A0 71 0C
		 28 00 FF 36
		 F0 11 30 03
		 00 00 00 0C
	];
};
